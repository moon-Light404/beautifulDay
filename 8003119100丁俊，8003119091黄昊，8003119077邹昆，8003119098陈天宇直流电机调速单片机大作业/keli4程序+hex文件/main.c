							 /**************************************************************************************************************/
#include<reg51.h>
#include<lcd1602.h>
/**************************************************************************************************************/
#ifndef uchar
#define uchar unsigned char
#endif
#ifndef uint 
#define uint unsigned int
#endif;
/**************************************************************************************************************/
#define KB	P0	//键盘P0
sbit M0=P1^0;		//步进电机驱动IO
sbit M1=P1^1;
sbit M2=P1^2;
sbit M3=P1^3;
sbit K0=P1^4;		//独立按键
sbit K1=P1^5;
sbit K2=P1^6;
sbit K3=P1^7;
sbit K_Rs=P3^2;
/**************************************************************************************************************/
uchar Disp1[]="Mode:Stop AntCLK";
uchar Disp2[]="Speed: 100 r/min";
uchar Kb_loc[]	={0xfe,0xfd,0xfb,0xf7};	//键盘逐行扫描
uchar Step[]		={0x0c,0x0d,0x09,0x0b,0x03,0x07,0x06,0x0e};	//单双步8拍(正转)
uint CT0=0;			//定时器T0计数
uint Cyc=80;		//电机八分频
char M=0,Dir=1;	//第M步,方向(1为顺时针正转,-1为逆时针反转)
bit Rs=0;
/**************************************************************************************************************/
void delay(uint i)		//延时函数
{
	for( ;i>0;i--);
}
/***********************************************键盘读取函数****************************************************/
uchar Key_scan(void)	//键盘读取函数
{
	uchar i=0;
	uchar key=0;				//键盘位置编码
	KB=0xf0;						//低4位清零
	for(i=0;i<4;i++)		
	{
		KB=Kb_loc[i];			//低4位循环扫描(行)
		if(KB!=Kb_loc[i])	//有按键按下
		{
			delay(10);			//延时消抖
			if(KB!=Kb_loc[i])
			{
				switch(KB&0xf0)	//判断高4位按下所在列
				{
					case (0xe0):	key=i*4+1; break;		//行数X4+列数=按键所在位置编码
					case (0xd0):	key=i*4+2; break;
					case (0xb0):	key=i*4+3; break;
					case (0x70):	key=i*4+4; break;
				}
			}		
		}
	}
	return key;		
}
/**************************************************************************************************************/
char ChangeChar(uchar i)		//char转字符
{
	switch(i){
		case 1: return '7'-'0';
		case 2: return '8'-'0';
		case 3: return '9'-'0';
		case 4: return 'e';			//除了数字其他均为end
		case 5: return '4'-'0';
		case 6: return '5'-'0';
		case 7: return '6'-'0';
		case 8: return 'e';		
		case 9: return '1'-'0';
		case 10: return '2'-'0';
		case 11: return '3'-'0';
		case 12: return 'e';	
		case 13: return 'e';	
		case 14: return '0'-'0';
		case 15: return 'e';	
		case 16: return 'e';	
	}
}
/******************************************************LCD1602****************************************************/
void Display(uchar n)			//LCD显示函数
{
	uchar i=0;
	LcdInit();			//lcd初始化
	for(i=0;i<3;i++)	//显示转速
	{
		if(n==0) 		//高位为0不显示
			Disp2[9-i]=' ';
		else
			Disp2[9-i]=n%10+'0'; //数据替换
		n/=10;
	}
	if(Rs)		//显示运行/停止
	{
		Disp1[5]='R';	Disp1[6]='u';	Disp1[7]='n';	Disp1[8]=' ';	//Run
	}
	if(!Rs)
	{
		Disp1[5]='S';	Disp1[6]='t';	Disp1[7]='o';	Disp1[8]='p';	//Stop
	}
	
	if(Dir==1)	//显示方向
	{
		Disp1[10]=' ';	Disp1[11]=' ';	Disp1[12]=' '; 	//   CLK
	}
	else if(Dir==-1)
	{
		Disp1[10]='A';	Disp1[11]='n';	Disp1[12]='t'; 	//AntCLK
	}
	
	for(i=0;i<16;i++)	//第一行显示
	{
		LcdWriteData(Disp1[i]);	
	}
	LcdWriteCom(0x40+0x80);	//第二行显示
	for(i=0;i<16;i++)
	{
		LcdWriteData(Disp2[i]);	
	}
}
/**************************************************************************************************************/
uint Keyboard(void)		//keyboard核心函数
{
	uchar key=0;		//按键位码
	char c=0;				//检测符号
	uchar i=0;
	uint n=0;			//初始化转速为100r/min
	if(key=Key_scan())
	{
		n=0;									//输入初始化
		while(1) 
		{	
			if(key=Key_scan())
			{
				KB=0xf0;		//高4位初始化为1,低4位强制为0,有按键按下则高4位有0
				while((KB&0xf0)!=0xf0);		//按键松开后进行后续操作
				c=ChangeChar(key);				//将转化后的字符保存在c中
				if(c=='e')
					break;		//字符退出键盘读取
				else
				{
					n=n*10+(uint)c;	//合成数据
					i++;
				}
			}
		Display(n);
		}
	}
	return n;		//返回被操作数
}
/*******************************************************MAIN函数****************************************************/
void main()
{
	uint n1=100;			//初始化转速
	uint n2=0;			//转速输入值

	/******************配置定时器******************/
	TMOD=0x01;			//T0定时
	TH0=0xfc;				//12Mhz定时1ms
	TL0=0x18;
	IT0=1;				//跳变沿出发方式（下降沿）
	EX0=1;				//打开INT0的中断允许
	EA=1;						//打开总中断
	ET0=1;					//打开二级中断开关
	
	while(1)
	{
		TR0=Rs;
		Display(n1);	
		
		/*******************四个按键控制正反转调速部分********************/
		if(K0==0&&K1!=0)		//正反转互锁(正转)
		{
			delay(10);
			if(K0==0&&K1!=0)
				Dir=1;				//方向字为1
		}
		if(K0!=0&&K1==0)	//正反转互锁(反转)
		{
			delay(10);
			if(K0!=0&&K1==0)
				Dir=-1;				//方向字为-1
		}
		if(K2==0&&K3!=0)	//加速减速互锁(加速)
		{
			delay(10);
			if(K2==0&&K3!=0)
			{
				while(K2==0);	//按键抬起
				n1++;					//转速+1
			}
		}
		if(K2!=0&&K3==0)	//加速减速互锁(减速)
		{
			delay(10);
			if(K2!=0&&K3==0)
			{
				while(K3==0);	//按键抬起
				n1--;					//转速-1
			}
		}
		/***************************************/
		n2=Keyboard();		//键盘读取输入转速
		if((n2>=20&&n2<=180))		//转速在20r/min -> 180r/min内则赋值否则不改变转速
			n1=n2;
		/***********调速与测速*************/
		Cyc=(uint)(125*60/(double)n1);		//调速程序
		/***********正反转控制*************/
		if(M<0||M>7)
		{
			if(Dir==1)					//正转
					M=0;
			else if(Dir==-1)		//反转
					M=7;
		}
	}
}
/***************************************************定时器T0中断函数****************************************************/
void Timer0() interrupt 1		//步进电机调速
{
	TH0=0xfc;		//定时1ms
	TL0=0x18;
	CT0++;
	if(CT0>=Cyc)	//调速(Cyc为1/8T)
	{
		M3=Step[M]&0x08;	//取第1位
		M2=Step[M]&0x04;	//取第2位
		M1=Step[M]&0x02;	//取第3位
		M0=Step[M]&0x01;	//取第4位
		M+=Dir;
		CT0=0;
	}
}
/*******************************************************外部中断0****************************************************/
void Int0() interrupt 0
{
	if(K_Rs==0)	//启停键按下
		Rs=~Rs;		//启停状态翻转
}
/*********************************************************************************************************************/
